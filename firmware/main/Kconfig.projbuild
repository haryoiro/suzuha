## firmware/main/Kconfig.projbuild
```kconfig
menu "Suzuha Physical Agent"

    config WIFI_SSID
        string "WiFi SSID"
        default ""
        help
            WiFi network name.

    config WIFI_PASSWORD
        string "WiFi Password"
        default ""
        help
            WiFi password.

    config SERVER_URI
        string "suzuha2 Server WebSocket URI"
        default "ws://192.168.1.100:9090/ws/device"
        help
            WebSocket endpoint on the suzuha2 server.

    config SERVO_PAN_GPIO
        int "Servo Pan GPIO"
        default 6
        help
            GPIO pin for the pan servo.

    config SERVO_TILT_GPIO
        int "Servo Tilt GPIO"
        default 7
        help
            GPIO pin for the tilt servo.

endmenu
```

## firmware/sdkconfig.defaults.esp32
```kconfig
# Target: ESP32 (ESP32-CAM)
CONFIG_IDF_TARGET="esp32"

# PSRAM (ESP32-CAM has 4MB PSRAM)
CONFIG_SPIRAM=y
CONFIG_SPIRAM_SPEED_80M=y

# WiFi
CONFIG_ESP_WIFI_STATIC_RX_BUFFER_NUM=10
CONFIG_ESP_WIFI_DYNAMIC_RX_BUFFER_NUM=32
CONFIG_ESP_WIFI_TX_BUFFER_TYPE=1
CONFIG_ESP_WIFI_DYNAMIC_TX_BUFFER_NUM=32
CONFIG_ESP_WIFI_DYNAMIC_RX_MGMT_BUF=1
CONFIG_ESP_WIFI_ESPNOW_MAX_ENCRYPT_NUM=7

# Camera
CONFIG_CAMERA_MODULE_ESP32_CAM=y

# FreeRTOS
CONFIG_FREERTOS_HZ=1000

# Partition table (3MB app partition)
CONFIG_PARTITION_TABLE_CUSTOM=y
CONFIG_PARTITION_TABLE_CUSTOM_FILENAME="partitions_esp32.csv"
CONFIG_ESPTOOLPY_FLASHSIZE_4MB=y

# Logging
CONFIG_LOG_DEFAULT_LEVEL_INFO=y
```

## firmware/sdkconfig.defaults.esp32p4
```kconfig
# Target: ESP32-P4
CONFIG_IDF_TARGET="esp32p4"

# Chip revision v1.x (v1.x and v3.x are mutually exclusive)
CONFIG_ESP32P4_SELECTS_REV_LESS_V3=y
CONFIG_ESP32P4_REV_MIN_100=y

# PSRAM
CONFIG_SPIRAM=y
CONFIG_SPIRAM_MODE_OCT=y
CONFIG_SPIRAM_SPEED_80M=y

# WiFi via ESP32-C6 co-processor (esp_wifi_remote)
CONFIG_ESP_WIFI_ENABLED=y
CONFIG_ESP_WIFI_REMOTE_ENABLED=y
CONFIG_ESP_WIFI_STATIC_RX_BUFFER_NUM=10
CONFIG_ESP_WIFI_DYNAMIC_RX_BUFFER_NUM=32
CONFIG_ESP_WIFI_TX_BUFFER_TYPE=1
CONFIG_ESP_WIFI_DYNAMIC_TX_BUFFER_NUM=32
CONFIG_ESP_WIFI_DYNAMIC_RX_MGMT_BUF=1
CONFIG_ESP_WIFI_ESPNOW_MAX_ENCRYPT_NUM=7

# Partition table (8MB app partition, 16MB flash)
CONFIG_PARTITION_TABLE_CUSTOM=y
CONFIG_PARTITION_TABLE_CUSTOM_FILENAME="partitions_esp32p4.csv"
CONFIG_ESPTOOLPY_FLASHSIZE_16MB=y

# FreeRTOS
CONFIG_FREERTOS_HZ=1000

# Camera sensor
CONFIG_CAMERA_OV5647=y

# Servo
CONFIG_SERVO_TILT_GPIO=5

# Logging
CONFIG_LOG_DEFAULT_LEVEL_INFO=y
```
